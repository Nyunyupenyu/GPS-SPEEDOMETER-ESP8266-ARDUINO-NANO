/*
 * Projek: Speedometer GPS IoT "Penyu" (Versi 2.14 - Smart Loop Sleep)
 * Fitur: Auto-Sleep OLED setelah 2x Putaran Carousel, Clean Signal Bars
 * Hardware: ESP8266, GPS NEO-6M, OLED SSD1306 (0.96 Inch)
 */

#include <Wire.h>
#include <Adafruit_GFX.h>
#include <Adafruit_SSD1306.h>
#include <TinyGPS++.h>
#include <SoftwareSerial.h>

// --- KONFIGURASI PORT (PIN) ---
#define SCREEN_WIDTH 128
#define SCREEN_HEIGHT 64
#define OLED_RESET -1
Adafruit_SSD1306 display(SCREEN_WIDTH, SCREEN_HEIGHT, &Wire, OLED_RESET);

static const int RXPin = D5; 
static const int TXPin = D6; 
static const uint32_t GPSBaud = 9600;

TinyGPSPlus gps;
SoftwareSerial ss(RXPin, TXPin);

enum SystemState {
  STATE_BOOTING,
  STATE_WELCOME,
  STATE_TITLE,
  STATE_CONNECTING,
  STATE_SPEEDOMETER,
  STATE_SCREENSAVER,
  STATE_SLEEP
};

SystemState currentState = STATE_BOOTING;
unsigned long stateTimer = 0;
unsigned long lastDisplayUpdate = 0;
unsigned long lastMoveTime = 0; 
unsigned long screensaverStartTime = 0; 

// Variabel Memori Global
double topSpeed = 0.0;
double lastAltitude = 0.0;
char altTrend = '-'; 
unsigned long lastAltTime = 0;

// --- DATA GAMBAR LOGO PENYU (128x64) ---
const unsigned char epd_bitmap_PENYUPUTIH [] PROGMEM = {
  0x00, 0x00, 0x00, 0x00, 0x00, 0x00, 0x00, 0x00, 0x00, 0x00, 0x00, 0x00, 0x00, 0x00, 0x00, 0x00, 
  0x00, 0x00, 0x00, 0x00, 0x00, 0x00, 0x00, 0x00, 0x00, 0x00, 0x00, 0x00, 0x00, 0x00, 0x00, 0x00, 
  0x00, 0x00, 0x00, 0x00, 0x00, 0x00, 0x00, 0x00, 0x00, 0x00, 0x00, 0x00, 0x00, 0x00, 0x00, 0x00, 
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  0x00, 0x00, 0x00, 0x00, 0x00, 0x00, 0x00, 0x00, 0x00, 0x00, 0x00, 0x00, 0x00, 0x00, 0x00, 0x00
};

void setOLEDContrast(uint8_t contrast) {
  Wire.beginTransmission(0x3C);
  Wire.write(0x00);
  Wire.write(0x81);
  Wire.write(contrast);
  Wire.endTransmission();
}

void setup() {
  Serial.begin(115200);
  ss.begin(GPSBaud);
  Wire.begin(D2, D1);

  if(!display.begin(SSD1306_SWITCHCAPVCC, 0x3C)) {
    Serial.println(F("Gagal menyalakan OLED"));
    for(;;);
  }
  
  stateTimer = millis();
}

void drawSignalBars(int satellites) {
  int x = 0;  
  int y = 9; 
  int activeBars = 0;
  
  if (satellites >= 3) activeBars = 1;
  if (satellites >= 5) activeBars = 2;
  if (satellites >= 7) activeBars = 3;
  if (satellites >= 9) activeBars = 4;

  for (int i = 0; i < activeBars; i++) {
    int barWidth = 3;
    int barHeight = 2 + (i * 2); 
    int barX = x + (i * 5);      
    int barY = y - barHeight;    

    display.fillRect(barX, barY, barWidth, barHeight, WHITE); 
  }
}

void loop() {
  while (ss.available() > 0) {
    gps.encode(ss.read());
  }
  
  int sats = gps.satellites.value();

  if (sats >= 3) {
    double tempSpeed = gps.speed.kmph();
    if (tempSpeed < 1.0) tempSpeed = 0.0;
    
    if (tempSpeed > topSpeed) {
      topSpeed = tempSpeed;
    }

    if (gps.altitude.isValid()) {
      double currentAlt = gps.altitude.meters();
      if (millis() - lastAltTime > 2000) {
        if (currentAlt > lastAltitude + 0.5) altTrend = 24;      
        else if (currentAlt < lastAltitude - 0.5) altTrend = 25; 
        else altTrend = '-';                                     
        lastAltitude = currentAlt;
        lastAltTime = millis();
      }
    }
  }

  switch (currentState) {
    
    case STATE_BOOTING: {
      display.clearDisplay();
      display.setTextColor(WHITE);
      display.setTextSize(1);
      display.setCursor(15, 10);
      display.print("System Booting...");

      unsigned long elapsed = millis() - stateTimer;
      int progressWidth = map(elapsed, 0, 1500, 0, 100);
      if (progressWidth > 100) progressWidth = 100;

      display.drawRect(14, 30, 100, 12, WHITE);
      display.fillRect(16, 32, progressWidth - 4, 8, WHITE);
      display.display();

      if (elapsed >= 1500) {
        currentState = STATE_WELCOME;
        stateTimer = millis();
        setOLEDContrast(0); 
      }
      break;
    }

    case STATE_WELCOME: {
      unsigned long elapsed = millis() - stateTimer;
      display.clearDisplay();
      display.drawBitmap(0, 0, epd_bitmap_PENYUPUTIH, 128, 64, WHITE);
      display.display();

      if (elapsed <= 2000) {
        int fadeValue = map(elapsed, 0, 2000, 0, 255);
        setOLEDContrast(fadeValue);
      } else if (elapsed >= 3000) {
        setOLEDContrast(255); 
        currentState = STATE_TITLE; 
        stateTimer = millis();
      }
      break;
    }

    case STATE_TITLE: {
      display.clearDisplay();
      display.setTextSize(2);
      display.setCursor(45, 10);
      display.print("GPS");
      display.setTextSize(1);
      display.setCursor(30, 32);
      display.print("SPEEDOMETER");
      display.setCursor(28, 48);
      display.print("Satuan: KM/H");
      display.display();

      if (millis() - stateTimer >= 2500) {
        currentState = STATE_CONNECTING;
        lastDisplayUpdate = millis();
      }
      break;
    }

    case STATE_CONNECTING: {
      if (millis() - lastDisplayUpdate > 80) { 
        lastDisplayUpdate = millis();
        display.clearDisplay();
        display.setTextSize(1);
        display.setCursor(18, 0);
        display.print("Mencari Sinyal");
        
        int cx = 64, cy = 28; 
        int r1 = (millis() / 40) % 20; 
        int r2 = (r1 + 10) % 20; 
        
        display.fillCircle(cx, cy, 2, WHITE); 
        display.drawCircle(cx, cy, r1, WHITE);
        display.drawCircle(cx, cy, r2, WHITE);

        display.setCursor(10, 52);
        display.print("Satelit Ditemukan: ");
        display.print(sats);
        display.display();
      }

      if (sats >= 3) {
        currentState = STATE_SPEEDOMETER;
        lastMoveTime = millis(); 
      }
      break;
    }

    case STATE_SPEEDOMETER: {
      double currentSpeed = gps.speed.kmph();
      if (currentSpeed < 1.0) currentSpeed = 0.0;

      if (currentSpeed > 0.0) {
        lastMoveTime = millis(); 
      } else if (millis() - lastMoveTime > 4000) {
        currentState = STATE_SCREENSAVER;
        screensaverStartTime = millis(); 
        display.clearDisplay();
        break;
      }

      if (millis() - lastDisplayUpdate > 100) {
        lastDisplayUpdate = millis();
        display.clearDisplay();

        if (sats < 3) {
          currentState = STATE_CONNECTING;
          break;
        }

        int hour = gps.time.hour() + 7;
        int day = gps.date.day();
        int month = gps.date.month();
        if (hour >= 24) { hour -= 24; day += 1; }

        char timeString[6];
        char dateString[6];
        sprintf(timeString, "%02d:%02d", hour, gps.time.minute());
        sprintf(dateString, "%02d/%02d", day, month);

        drawSignalBars(sats); 
        display.setTextSize(1);
        display.setCursor(45, 1); 
        if (gps.time.isValid()) display.print(timeString); else display.print("--:--");
        display.setCursor(92, 1); 
        display.print("Sat:"); display.print(sats);
        display.drawLine(0, 11, 128, 11, WHITE); 

        int speedInt = (int)currentSpeed;
        display.setTextSize(5); 

        if (speedInt < 10) {
          display.setCursor(25, 20); 
          display.print(speedInt);

          int rightX = 95; 
          display.setTextSize(1); 
          display.setCursor(rightX, 14); display.print("MAX");
          display.setCursor(rightX, 23); display.print((int)topSpeed);

          display.setCursor(rightX, 34); display.print("MDPL");
          display.setCursor(rightX, 43);
          if (gps.altitude.isValid()) {
            display.print(altTrend); 
            display.print((int)gps.altitude.meters()); 
          } else {
            display.print("-");
          }

          display.setCursor(rightX, 54);
          if (gps.date.isValid()) display.print(dateString); else display.print("--/--/----");

        } else {
          if (speedInt < 100) display.setCursor(34, 20); 
          else display.setCursor(19, 20);
          display.print(speedInt);
        }

        display.display();
      }
      break;
    }

    case STATE_SCREENSAVER: {
      double currentSpeed = gps.speed.kmph();
      if (currentSpeed < 1.0) currentSpeed = 0.0;
      
      if (currentSpeed > 0.0) {
        lastMoveTime = millis();
        setOLEDContrast(255); 
        currentState = STATE_SPEEDOMETER;
        display.clearDisplay();
        break;
      }

      // 2x putaran carousel penuh = 2 x 12000 ms = 24000 ms (24 detik)
      if (millis() - screensaverStartTime > 24000) {
        currentState = STATE_SLEEP;
        display.clearDisplay();
        display.ssd1306_command(SSD1306_DISPLAYOFF); 
        break;
      }

      if (millis() - lastDisplayUpdate > 200) { 
        lastDisplayUpdate = millis();
        display.clearDisplay();

        if (sats < 3) {
          currentState = STATE_CONNECTING;
          break;
        }

        int hour = gps.time.hour() + 7;
        int day = gps.date.day();
        int month = gps.date.month();
        if (hour >= 24) { hour -= 24; day += 1; }

        char timeString[6];
        char dateStringLong[11];
        char dateStringShort[6];
        
        sprintf(timeString, "%02d:%02d", hour, gps.time.minute());
        sprintf(dateStringLong, "%02d/%02d/%04d", day, month, gps.date.year());
        sprintf(dateStringShort, "%02d/%02d", day, month);

        unsigned long carouselTimer = (millis() - screensaverStartTime) % 12000;
        int page = carouselTimer / 3000; 

        if (page == 0) {
          display.drawBitmap(0, 0, epd_bitmap_PENYUPUTIH, 128, 64, WHITE);
        } 
        else if (page == 1) {
          drawSignalBars(sats);
          display.setTextSize(1);
          display.setCursor(92, 1);
          display.print("Sat:"); display.print(sats);
          display.drawLine(0, 11, 128, 11, WHITE);

          display.setTextSize(3);
          display.setCursor(19, 20); 
          if (gps.time.isValid()) display.print(timeString); else display.print("--:--");

          display.setTextSize(1);
          display.setCursor(35, 52); 
          if (gps.date.isValid()) display.print(dateStringLong); else display.print("--/--/----");
        } 
        else if (page == 2) {
          display.setTextSize(2);
          display.setCursor(0, 5);
          display.print("Alt:");
          if (gps.altitude.isValid()) display.print((int)gps.altitude.meters()); else display.print("-");
          display.print(" m");

          display.setTextSize(1);
          display.setCursor(0, 32);
          display.print("Lat: ");
          if (gps.location.isValid()) display.print(gps.location.lat(), 6); else display.print("Mencari...");

          display.setCursor(0, 48);
          display.print("Lon: ");
          if (gps.location.isValid()) display.print(gps.location.lng(), 6); else display.print("Mencari...");
        }
        else if (page == 3) {
          drawSignalBars(sats); 
          display.setTextSize(1);
          display.setCursor(45, 1); 
          if (gps.time.isValid()) display.print(timeString); else display.print("--:--");
          display.setCursor(92, 1); 
          display.print("Sat:"); display.print(sats);
          display.drawLine(0, 11, 128, 11, WHITE); 

          display.setTextSize(5); 
          display.setCursor(25, 20); 
          display.print((int)currentSpeed); 

          int rightX = 95; 
          display.setTextSize(1); 
          display.setCursor(rightX, 14); display.print("MAX");
          display.setCursor(rightX, 23); display.print((int)topSpeed);

          display.setCursor(rightX, 34); display.print("MDPL");
          display.setCursor(rightX, 43);
          if (gps.altitude.isValid()) {
            display.print(altTrend); 
            display.print((int)gps.altitude.meters()); 
          } else {
            display.print("-");
          }

          display.setCursor(rightX, 54);
          if (gps.date.isValid()) display.print(dateStringShort); else display.print("--/--");
        }

        display.display();
      }
      break;
    }

    case STATE_SLEEP: {
      double currentSpeed = gps.speed.kmph();
      if (currentSpeed < 1.0) currentSpeed = 0.0;

      if (currentSpeed > 0.0) {
        lastMoveTime = millis();
        display.ssd1306_command(SSD1306_DISPLAYON); 
        setOLEDContrast(255);                     
        currentState = STATE_SPEEDOMETER;           
        display.clearDisplay();
        break;
      }
      break;
    }
  }
}